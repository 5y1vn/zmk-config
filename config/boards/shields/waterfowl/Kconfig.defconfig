## config/boards/shields/waterfowl/Kconfig.defconfig
```kconfig
if SHIELD_WATERFOWL_CENTRAL_DONGLE

config ZMK_KEYBOARD_NAME
    default "Waterfowl"

config ZMK_SPLIT_ROLE_CENTRAL
    default y

config ZMK_SPLIT_BLE_CENTRAL_PERIPHERALS
    default 2

choice BT_CTLR_TX_PWR
    default config BT_CTLR_TX_PWR_8
endchoice

endif

if SHIELD_WATERFOWL_CENTRAL_DONGLE || SHIELD_WATERFOWL_LEFT || SHIELD_WATERFOWL_RIGHT

config ZMK_SPLIT
    default y

if ZMK_DISPLAY

config I2C
    default y

config SSD1306
    default y

endif # ZMK_DISPLAY

if LVGL

config LV_Z_VDB_SIZE
    default 64

config LV_DPI_DEF
    default 148

config LV_Z_BITS_PER_PIXEL
    default 1

choice LV_COLOR_DEPTH
    default LV_COLOR_DEPTH_1
endchoice

endif # LVGL

endif


if SHIELD_WATERFOWL_LEFT

    # Setting this to y will make the left half the central
    # We want it to be the central when dongle is not used
    config ZMK_SPLIT_ROLE_CENTRAL
        default y

    # Check if the left half is the central
    if ZMK_SPLIT_ROLE_CENTRAL
        config ZMK_KEYBOARD_NAME
            default "Waterfowl"
            
    endif # ZMK_SPLIT_ROLE_CENTRAL

endif # SHIELD_WATERFOWL_LEFT
```
